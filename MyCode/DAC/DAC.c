#include "DAC.h"

/*-------------------------------------------------------记录设定值相关变量-------------------------------------------------------*/
/*--------------------------------------------------------------------------------------------------------------------------------*/
float Set_Voltage_before=0;//记录上次的电压值，初始为0
float Set_Current_before=0;//记录上次的电流值，初始为0
/*------------------------------------------------------默认缓升模式相关变量------------------------------------------------------*/
/*--------------------------------------------------------------------------------------------------------------------------------*/
/*改进后的版本*/
uint32_t V_Slope_default;//电压默认变化率
uint32_t I_Slope_default;//电流默认变化率


uint8_t V_Rise_On_Off = V_Rise_Off;
uint8_t V_Fall_On_Off = V_Fall_Off;
uint8_t I_Rise_On_Off = I_Rise_Off;
uint8_t I_Fall_On_Off = I_Fall_Off;


extern uint8_t Uart2_Send_buffer[9];

#ifdef CRC16_CHECK
const unsigned char auchCRCHi[]=
{
		0x00, 0xC1, 0x81, 0x40, 0x01, 0xC0, 0x80, 0x41, 0x01, 0xC0, 0x80, 0x41, 0x00, 0xC1, 0x81,
        0x40, 0x01, 0xC0, 0x80, 0x41, 0x00, 0xC1, 0x81, 0x40, 0x00, 0xC1, 0x81, 0x40, 0x01, 0xC0,
        0x80, 0x41, 0x01, 0xC0, 0x80, 0x41, 0x00, 0xC1, 0x81, 0x40, 0x00, 0xC1, 0x81, 0x40, 0x01,
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        0x00, 0xC1, 0x81, 0x40, 0x01, 0xC0, 0x80, 0x41, 0x01, 0xC0, 0x80, 0x41, 0x00, 0xC1, 0x81,
        0x40
};
const unsigned char auchCRCLo[] =
{
        0x00, 0xC0, 0xC1, 0x01, 0xC3, 0x03, 0x02, 0xC2, 0xC6, 0x06, 0x07, 0xC7, 0x05, 0xC5, 0xC4,
        0x04, 0xCC, 0x0C, 0x0D, 0xCD, 0x0F, 0xCF, 0xCE, 0x0E, 0x0A, 0xCA, 0xCB, 0x0B, 0xC9, 0x09,
        0x08, 0xC8, 0xD8, 0x18, 0x19, 0xD9, 0x1B, 0xDB, 0xDA, 0x1A, 0x1E, 0xDE, 0xDF, 0x1F, 0xDD,
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        0x44, 0x84, 0x85, 0x45, 0x87, 0x47, 0x46, 0x86, 0x82, 0x42, 0x43, 0x83, 0x41, 0x81, 0x80,
        0x40
};
uint16_t CRC16(uint8_t *puchMsg,uint8_t usDataLen )
{
		unsigned char uchCRCHi=0xFF;
		unsigned char uchCRCLo=0xFF;
		unsigned uIndex;
		while(usDataLen--)
		{
			uIndex =uchCRCLo^*puchMsg++;
			uchCRCLo=uchCRCHi^auchCRCHi[uIndex];
			uchCRCHi=auchCRCLo[uIndex];
		}
		return (uchCRCHi<<8|uchCRCLo);
}
#endif
uint16_t ADD(uint8_t *puchMsg,uint8_t usDataLen)
{

	uint16_t sum=0;
	uint8_t * pindex=puchMsg;
	for(uint8_t i=0;i<usDataLen;i++)
	{
		sum+=*(pindex++);
	}

	return sum;
}
/**
  * @brief  send command to mcu
  * @param  IDindex:machine id
  * @param  command
  * @param  Date need to be send
  * @retval
  */
void DAC_Cmd_send(uint8_t IDindex,uint8_t cmd,uint16_t Data_To_Send)
{

	__HAL_UART_ENABLE(&huart2);
	memset(&Uart2_Send_buffer[0],0,9);
	/*********************ID&Command*********************/
	Uart2_Send_buffer[0]=IDindex;//id
	Uart2_Send_buffer[1]=cmd;//cmd
	 /*********************data length*********************/
	 if((Data_To_Send&0xff00))
	 {
		 Uart2_Send_buffer[2]=0x02;
	 }
	 else if((Data_To_Send&0x00ff))
	 {
		 Uart2_Send_buffer[2]=0x01;
	 }
	 else Uart2_Send_buffer[2]=0x00;
	 /*********************data convert*********************/
	  Uart2_Send_buffer[3]=0x00;//data H
	  Uart2_Send_buffer[4]=0x00;//data L
	  switch(cmd)
	  {
		  case 0://pwm EN
		  case 1:break;//read voltage
		  case 2:break;//loop read
		  case 3:break;//read current

		  /*set max voltage current*/
		  case 4://set voltage
		  case 5://set current
		  {
			  Uart2_Send_buffer[4]|=(Data_To_Send&0x00ff);//low max_voltage
			  Uart2_Send_buffer[3]|=(Data_To_Send>>8);//Hight max_voltage
			  break;
		  }
		  /*set min voltage current*/
		  case 6://set voltage & current
		  {

			  Uart2_Send_buffer[4]|=(Set_Voltage&0x00ff);//low voltage
			  Uart2_Send_buffer[3]|=(Set_Voltage>>8);//Hight voltage

			  Uart2_Send_buffer[6]|=(Set_Current&0x00ff);//low current
			  Uart2_Send_buffer[5]|=(Set_Current>>8);//Hight current
			  break;

		  }
		  /*set V/I rate*/
		  case 7:
		  case 8:
		  {
			  Uart2_Send_buffer[4]|=(Data_To_Send&0x00ff);//Low min_voltage
			  break;
		  }
		  /*set V I rate*/
		  case 9:
		  {
			  Uart2_Send_buffer[4]|=(Data_To_Send&0x00ff);//Low min_voltage
			  Uart2_Send_buffer[3]|=(Data_To_Send>>8);//high min_voltage
			  break;
		  }

		  case 11:break;//start Fall ON/OFF

		  default: break;
	  }
#ifdef CRC16_CHECK
	  /*********************CRC Calculate*********************/
	  Uart2_Send_buffer[5]=CRC16(Uart2_Send_buffer,5);//CRC L
	  Uart2_Send_buffer[6]=(CRC16(Uart2_Send_buffer,5)>>8);//CRC H
#endif
#ifdef ADD_CHECK
	  Uart2_Send_buffer[7]=ADD(Uart2_Send_buffer,7);//Low
	  Uart2_Send_buffer[8]=(ADD(Uart2_Send_buffer,7)>>8);//High
#endif

	  HAL_UART_Transmit_IT(&huart2,Uart2_Send_buffer,9);

}

/**
  * @brief  开始输出
  * @param  无
  * @retval 无
  */
void power_on(void)
{


	ON_OFF =ON;
	DAC_Cmd_send(1,6,0);

}
/**
  * @brief  关闭输出
  * @param  无
  * @retval 无
  */
void power_off(void)
{

	ON_OFF =OFF;
	uint16_t temp_V=Set_Voltage;
	uint16_t temp_I=Set_Current;
	Set_Voltage=100;
	Set_Current=100;
	DAC_Cmd_send(1,6,0);
	Set_Voltage=temp_V;
	Set_Current=temp_I;

}
/**
  * @brief  输出零
  * @param  无
  * @retval 无
  */
void Output_Zero(void)
{

	uint16_t temp_V=Set_Voltage;
	uint16_t temp_I=Set_Current;
	Set_Voltage=10;
	Set_Current=10;
	DAC_Cmd_send(1,6,0);
	Set_Voltage=temp_V;
	Set_Current=temp_I;


}
/**
  * @brief  默认缓升功能
  * @param  无
  * @retval 无
  */
void Slope_Function_On_default(void)
{
	/*默认缓升，输出打开*/
	ON_OFF = ON;
	DAC_Cmd_send(1,0x00,0x0000);//使能输出
	/*没有开用户缓升功能，使用默认电压缓升模式*/
	DAC_Cmd_send(1,0x07,V_Slope_Max);//设定默认斜率
	DAC_Cmd_send(1,0x00,0x0000);//使能输出
	/*没有开用户缓降功能，使用默认电流缓升模式*/
	DAC_Cmd_send(1,0x07,V_Slope_Default);//设定默认斜率
	DAC_Cmd_send(1,0x07,I_Slope_Default);//设定默认斜率
	DAC_Cmd_send(1,0x08,Set_Current);//用户设定的目标电流值
	DAC_Cmd_send(1,0x08,Set_Voltage);//用户设定的目标电流值
	DAC_Cmd_send(1,0x0a,0x00);
	DAC_Cmd_send(1,0x0a,0x02);
}
/**
  * @brief  默认缓降功能
  * @param  无
  * @retval 无
  */
void Slope_Function_Off_default(void)
{
	/*默认缓降，输出关闭*/
	ON_OFF = OFF;
	DAC_Cmd_send(1,0x00,0x0000);//使能输出
	/*没有开用户缓升功能，使用默认电压缓降模式*/
	DAC_Cmd_send(1,0x07,V_Slope_Max);//设定默认斜率
	/*没有开用户缓降功能，使用默认电流缓降模式*/
	DAC_Cmd_send(1,0x07,V_Slope_Default);//设定默认斜率
	DAC_Cmd_send(1,0x07,I_Slope_Default);//设定默认斜率
	DAC_Cmd_send(1,0x08,Set_Current);//用户设定的目标电流值
	DAC_Cmd_send(1,0x08,Set_Voltage);//用户设定的目标电流值
	DAC_Cmd_send(1,0x0a,0x01);
	DAC_Cmd_send(1,0x0a,0x03);

}

/**
  * @brief  用户设定缓升功能函数
  * @param  None
  * @retval None
  */
void Slope_Function_On(void)
{
	/*用户缓升，输出关闭*/
	ON_OFF = ON;
	/*用户电压缓升功能打开*/
	DAC_Cmd_send(1,0x08,0x00);//设定电压变化最低点
	DAC_Cmd_send(1,0x04,0x00);//设定电流变化最低点
	if (V_Rise_On_Off == V_Rise_On)
	{

		DAC_Cmd_send(1,0x08,Set_Voltage);//用户设定的目标电压值
		DAC_Cmd_send(1,0x07,Set_V_Slope);
		DAC_Cmd_send(1,0x00,0x0000);//使能输出
		DAC_Cmd_send(1,0x0a,0x0000);//使能电压缓升
	}
	/*用户电压缓升功能打开*/
	if (I_Rise_On_Off == I_Rise_On)
	{
		DAC_Cmd_send(1,0x08,Set_Current);//用户设定的目标电流值
		DAC_Cmd_send(1,0x07,Set_I_Slope);
		DAC_Cmd_send(1,0x00,0x0000);//使能输出
		DAC_Cmd_send(1,0x0a,0x0002);//使能电流缓升
	}
}

/**
  * @brief  用户设定缓降功能函数
  * @param  None
  * @retval None
  */
void Slope_Function_Off(void)
{
	/*用户缓降，输出关闭*/
	ON_OFF = OFF;
	/*用户电压缓降功能打开*/
	DAC_Cmd_send(1,0x08,0x00);//设定电压变化最低点
	DAC_Cmd_send(1,0x04,0x00);//设定电流变化最低点
	if (V_Fall_On_Off == V_Fall_On)
	{
		DAC_Cmd_send(1,0x08,Set_Voltage);//用户设定的目标电压值
		DAC_Cmd_send(1,0x07,Set_V_Slope);//设定用户电压变化率
		DAC_Cmd_send(1,0x00,0x0000);//使能输出
		DAC_Cmd_send(1,0x0a,0x0000);//使能电压缓降
	}
	/*用户电流缓降功能打开*/
	if (I_Fall_On_Off == I_Fall_On)
	{
		DAC_Cmd_send(1,0x08,Set_Current);//用户设定的目标电流值
		DAC_Cmd_send(1,0x07,Set_I_Slope);//设定用户电流变化率
		DAC_Cmd_send(1,0x00,0x0000);//使能输出
		DAC_Cmd_send(1,0x0a,0x0002);//使能电流缓降
	}

}



