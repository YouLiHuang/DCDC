#include "RS232.h"


extern DMA_HandleTypeDef hdma_usart3_rx;
uint8_t USART3_Num;//USART接收字节数
uint8_t USART3_Send_Data[20];  //发送数据数组
uint8_t USART3_Receive_Data[20]; //接收数据数组
uint8_t USART3_Receive_Data_buffer[2];
uint8_t USART3_Need_To_Send_Num;//需发送数据字节数
uint16_t CrcValue;//校验码
uint16_t AddValue;

const unsigned char auchCRCHi[]=
{
		0x00, 0xC1, 0x81, 0x40, 0x01, 0xC0, 0x80, 0x41, 0x01, 0xC0, 0x80, 0x41, 0x00, 0xC1, 0x81,
        0x40, 0x01, 0xC0, 0x80, 0x41, 0x00, 0xC1, 0x81, 0x40, 0x00, 0xC1, 0x81, 0x40, 0x01, 0xC0,
        0x80, 0x41, 0x01, 0xC0, 0x80, 0x41, 0x00, 0xC1, 0x81, 0x40, 0x00, 0xC1, 0x81, 0x40, 0x01,
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        0x00, 0xC1, 0x81, 0x40, 0x01, 0xC0, 0x80, 0x41, 0x01, 0xC0, 0x80, 0x41, 0x00, 0xC1, 0x81,
        0x40
};
const unsigned char auchCRCLo[] =
{
        0x00, 0xC0, 0xC1, 0x01, 0xC3, 0x03, 0x02, 0xC2, 0xC6, 0x06, 0x07, 0xC7, 0x05, 0xC5, 0xC4,
        0x04, 0xCC, 0x0C, 0x0D, 0xCD, 0x0F, 0xCF, 0xCE, 0x0E, 0x0A, 0xCA, 0xCB, 0x0B, 0xC9, 0x09,
        0x08, 0xC8, 0xD8, 0x18, 0x19, 0xD9, 0x1B, 0xDB, 0xDA, 0x1A, 0x1E, 0xDE, 0xDF, 0x1F, 0xDD,
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        0x44, 0x84, 0x85, 0x45, 0x87, 0x47, 0x46, 0x86, 0x82, 0x42, 0x43, 0x83, 0x41, 0x81, 0x80,
        0x40
};
uint16_t CRC16(uint8_t *puchMsg,uint8_t usDataLen )
{
		unsigned char uchCRCHi=0xFF;
		unsigned char uchCRCLo=0xFF;
		unsigned uIndex;
		while(usDataLen--)
		{
			uIndex =uchCRCLo^*puchMsg++;
			uchCRCLo=uchCRCHi^auchCRCHi[uIndex];
			uchCRCHi=auchCRCLo[uIndex];
		}
		return (uchCRCHi<<8|uchCRCLo);
}

/**
  * @brief  USART发送报文
  * @param  无
  * @retval 无
  */
void USART3_Send(void)
{

	HAL_GPIO_WritePin(GPIOA,GPIO_PIN_15,GPIO_PIN_SET);
	HAL_UART_DMAStop(&huart3);

	HAL_UART_Transmit_DMA(&huart3,USART3_Send_Data,USART3_Need_To_Send_Num);

	__HAL_UART_CLEAR_FLAG(&huart3,UART_CLEAR_TCF);
	__HAL_UART_ENABLE_IT(&huart3, UART_IT_TC);

}
/**
  * @brief  CRC 16位转8位
  * @param  X-16位数据   *t-8位数据地址
  * @retval 无
  */
void uint16_t_to_uint8_t(uint16_t x,uint8_t *t)
{
	*(t+1)=x;
	*t=x>>8;
}

static void function20(void)
{

	USART3_Send_Data [0]=(uint8_t)RS232_ID;
	USART3_Send_Data [1]=0x20;
	USART3_Send_Data [2]=0x01;


	if(USART3_Receive_Data[3]==ON)
	{
		OUTPUT_NOT_OUTPUT = OUTPUT;
		if(Delay_Function_On_Off == Delay_Function_On)               //打开了延时功能
		{
			TIM16_DELAY_ON();
		}
		else if(Cycle_Function_On_Off == Cycle_Function_On)          //打开了循环功能
		{
			TIM17_CYCLE_ON();
		}
		else
		{
			power_on();
		}
	}
	else
	{
		OUTPUT_NOT_OUTPUT = NOT_OUTPUT;
		TIM16_DELAY_OFF();
		TIM17_CYCLE_OFF();
		power_off();
	}
	USART3_Send_Data [3]=USART3_Receive_Data[3];

	CrcValue = CRC16( USART3_Send_Data, 4) ;
	USART3_Send_Data [4]=CrcValue&0xff;
	USART3_Send_Data [5]=((CrcValue>>8)&0xff);
	USART3_Need_To_Send_Num =6;
	USART3_Send ();
}

/**
  * @brief  设定输出电压命令：0x21
  * @param  无
  * @retval 无
  */
static void function21(void)
{

	USART3_Send_Data [0]=(uint8_t)RS232_ID;//本机ID
	USART3_Send_Data [1]=0x21;//指令类型
	USART3_Send_Data [2]=0x02;


	Set_Voltage=(USART3_Receive_Data[3]<<8|USART3_Receive_Data[4])/100.0;
	CV_CC_CP = CV;
	AT25_Save_VISet();
	AT25_Save_CC_CV_CP();


	USART3_Send_Data [3]=USART3_Receive_Data[3];
	USART3_Send_Data [4]=USART3_Receive_Data[4];


	CrcValue = CRC16( USART3_Send_Data, 5) ;
	USART3_Send_Data [5]=CrcValue&0xff;
	USART3_Send_Data [6]=(CrcValue>>8)&0xff;
	USART3_Need_To_Send_Num =7;
	USART3_Send ();


}
/**
  * @brief  设定输出电流命令：0x22
  * @param  无
  * @retval 无
  */
static void function22(void)
{

	USART3_Send_Data [0]=(uint8_t)RS232_ID ;
	USART3_Send_Data [1]=0x22;
	USART3_Send_Data [2]=0x02;


	//立浩要改  这里设定电流
    Set_Current=(USART3_Receive_Data[3]<<8|USART3_Receive_Data[4])/100.0;
	CV_CC_CP = CC;
	AT25_Save_VISet();
	AT25_Save_CC_CV_CP();

	USART3_Send_Data [3]=USART3_Receive_Data[3];
	USART3_Send_Data [4]=USART3_Receive_Data[4];

	CrcValue = CRC16( USART3_Send_Data, 5) ;
	USART3_Send_Data [5]=CrcValue&0xff;
	USART3_Send_Data [6]=(CrcValue>>8)&0xff;
	USART3_Need_To_Send_Num =7;
	USART3_Send ();

}




/**
  * @brief 读取电压及电流反馈数据：0x26
  * @param  无
  * @retval 无
  */
static void function26(void)
{

	USART3_Send_Data [0]=(uint8_t)RS232_ID;
	USART3_Send_Data [1]=0x26;
	USART3_Send_Data [2]=0x04;
	USART3_Send_Data [3]=(uint16_t)(Voltage_real*100)>>8;
	USART3_Send_Data [4]=(uint16_t)(Voltage_real*100);
	USART3_Send_Data [5]=(uint16_t)(Current_real*100)>>8;
	USART3_Send_Data [6]=(uint16_t)(Current_real*100);

	CrcValue = CRC16( USART3_Send_Data,7);
	USART3_Send_Data [7]=CrcValue&0xff;
	USART3_Send_Data [8]=(CrcValue>>8)&0xff;
	USART3_Need_To_Send_Num =9;
	USART3_Send ();

}


/**
  * @brief  读取电压、电流、功率最大值数据：0x27
  * @param  无
  * @retval 无
  */
static void function27(void)
{
	USART3_Send_Data [0]=(uint8_t)RS232_ID;
	USART3_Send_Data [1]=0x27;
	USART3_Send_Data [2]=0x06;

	USART3_Send_Data [3]=0x1f;
	USART3_Send_Data [4]=0x40;//8000
	USART3_Send_Data [5]=2;
	USART3_Send_Data [6]=0x27;
	USART3_Send_Data [7]=0x10;//10000
	USART3_Send_Data [8]=2;
	USART3_Send_Data [9]=0x17;
	USART3_Send_Data [10]=0x70;//6000
	USART3_Send_Data [11]=0;


	CrcValue = CRC16( USART3_Send_Data,12);
	USART3_Send_Data [12]=CrcValue&0xff;
	USART3_Send_Data [13]=(CrcValue>>8)&0xff;
	USART3_Need_To_Send_Num =14;
	USART3_Send ();
}


/**
  * @brief  读取电压及电流设定输出数据：0x28
  * @param  无
  * @retval 无
  */
static void function28(void)
{

	USART3_Send_Data [0]=(uint8_t)RS232_ID;
	USART3_Send_Data [1]=0x28;
	USART3_Send_Data [2]=0x05;

	USART3_Send_Data [3]=ON_OFF;
	USART3_Send_Data [4]=(uint16_t)(Set_Voltage*100)>>8;
	USART3_Send_Data [5]=(uint16_t)(Set_Voltage*100);
	USART3_Send_Data [6]=(uint16_t)(Set_Current*100)>>8;
	USART3_Send_Data [7]=(uint16_t)(Set_Current*100);


	CrcValue =CRC16(USART3_Send_Data ,8);
	USART3_Send_Data [8]=CrcValue&0xff;
	USART3_Send_Data [9]=(CrcValue>>8)&0xff;
	USART3_Need_To_Send_Num =10;
	USART3_Send ();
}

/**
  * @brief  设定机器编号：0x29
  * @param  无
  * @retval 无
  */
static void function29(void)
{
	USART3_Send_Data[0]=(uint8_t)RS232_ID ;
	USART3_Send_Data[1]=0x29;
	USART3_Send_Data[2]=0x01;

	RS232_ID = (uint16_t)USART3_Receive_Data[3];
	USART3_Send_Data[3]=USART3_Receive_Data[3];

	CrcValue =CRC16 (USART3_Send_Data,4);
	USART3_Send_Data [4]=CrcValue&0xff;
	USART3_Send_Data [5]=(CrcValue>>8)&0xff;
	USART3_Need_To_Send_Num =6;
	USART3_Send ();
}

/**
  * @brief  读取电压及电流反馈数据：0x2a
  * @param  无
  * @retval 无
  */
static void function2a(void)
{
	USART3_Send_Data[0]=(uint8_t)RS232_ID ;
	USART3_Send_Data[1]=0x2a;
	USART3_Send_Data[2]=0x05;

	USART3_Send_Data [3]=ON_OFF ;
	USART3_Send_Data [4]=(uint16_t)(Voltage_real*100)>>8;
	USART3_Send_Data [5]=(uint16_t)(Voltage_real*100);
	USART3_Send_Data [6]=(uint16_t)(Current_real*100)>>8;
	USART3_Send_Data [7]=(uint16_t)(Current_real*100);

	CrcValue =CRC16 (USART3_Send_Data,8);
	USART3_Send_Data [8]=CrcValue&0xff;
	USART3_Send_Data [9]=(CrcValue>>8)&0xff;
	USART3_Need_To_Send_Num =10;
	USART3_Send ();
}

void USART3_Handler(void)
{

	if((USART3_Receive_Data [0] == (uint8_t)RS232_ID ) || (USART3_Receive_Data [0] ==0))
	{
		CrcValue=((USART3_Receive_Data [USART3_Num-2])|((uint16_t)(USART3_Receive_Data[USART3_Num -1])<<8));
		if(CrcValue==CRC16(USART3_Receive_Data,USART3_Num-2 ))
		{
			switch(USART3_Receive_Data [1])
			{
				case 0x20:function20();break;
				case 0x21:function21();break;
				case 0x22:function22();break;

				case 0x26:function26();break;
				case 0x27:function27();break;
				case 0x28:function28();break;
				case 0x29:function29();break;
				case 0x2a:function2a();break;

				default: break;
			}
		}
		else return;
	}
	else return;


}
/**
  * @brief  RS232接收中断,来自电脑端指令
  * @param  无
  * @retval 无
  */
void RS232_IT(void)
{
	if(__HAL_UART_GET_IT(&huart3,UART_IT_ERR)==SET)
	{
		HAL_UART_Receive_IT(&huart3, USART3_Receive_Data,2);
		__HAL_UART_CLEAR_FLAG(&huart3,UART_CLEAR_OREF);

	}
	/*USART1_RDE PIN Control*/
	if(__HAL_UART_GET_IT(&huart3,UART_IT_TC)==SET)
	{
		__HAL_UART_DISABLE_IT(&huart3, UART_IT_TC);
		__HAL_UART_CLEAR_FLAG(&huart3,UART_CLEAR_TCF);
		HAL_GPIO_WritePin(GPIOA,GPIO_PIN_15,GPIO_PIN_RESET);
	}
	if(__HAL_UART_GET_IT(&huart3,UART_IT_IDLE)==SET)
	{

		HAL_UART_DMAStop(&huart3);
		USART3_Num=50-__HAL_DMA_GET_COUNTER(&hdma_usart3_rx);
		hdma_usart3_rx.Instance->CNDTR=50;
		HAL_UART_Receive_DMA(&huart3,USART3_Receive_Data, USART3_Num);
		USART3_Handler();
		__HAL_UART_CLEAR_FLAG(&huart3,UART_CLEAR_IDLEF);

	}

}
